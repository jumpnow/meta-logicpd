## conf/machine/logicpd.conf
```bitbake
#@TYPE: Machine
#@NAME: LogicPD machine
#@DESCRIPTION: Machine configuration for the LogicPD OMAP3 

SOC_FAMILY = "omap3"
TARGET_ARCH = "arm"

DEFAULTTUNE = "cortexa8hf-neon"

require conf/machine/include/soc-family.inc
require conf/machine/include/arm/armv7a/tune-cortexa8.inc

PREFERRED_PROVIDER_virtual/kernel = "linux-stable"

PREFERRED_PROVIDER_virtual/bootloader = "u-boot"
PREFERRED_PROVIDER_u-boot = "u-boot"

UBOOT_ENTRYPOINT = "0x80008000"
UBOOT_LOADADDRESS = "0x80008000"
UBOOT_MACHINE = "omap3_logic_config"

EXTRA_IMAGEDEPENDS += "u-boot"

SERIAL_CONSOLES = "115200;ttyO2"

IMAGE_FSTYPES = "tar.xz"

MACHINE_ESSENTIAL_EXTRA_RDEPENDS = "kernel-image kernel-modules kernel-devicetree"

MACHINE_FEATURES = "ext2 serial usbhost vfat"
```
